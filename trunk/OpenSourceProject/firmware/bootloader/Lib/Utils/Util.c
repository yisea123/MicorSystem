/**
  ******************************************************************************
  *                     (c) Copyright 2015, tangmingfei2013@126.com
  *                           All Rights Reserved
  * @file    util.c
  * @author  mingfei tang
  * @version V1.0.0
  * @date    2015/01/10
  * @description:
    This source code and any compilation or derivative thereof is the proprietary
    information of mingfei.tang and is confidential in nature.
    Under no circumstances is this software to be combined with any
    Open Source Software in any way or placed under an Open Source License
    of any type without the express written permission of mingfei.tang
  ******************************************************************************
**/
#include "stm32f10x.h"
#include <stdint.h>
#include <stdarg.h>
#include <string.h>
#include <stdbool.h>
#include <stdio.h>
#include <stddef.h>
#include <stdlib.h>
#include <ctype.h>
#include "Util.h"

static void (*Reset)( void ) = (void (*)(void))0x08000000;

uint16_t crc_16_tab[] = {
  0x0000, 0xc0c1, 0xc181, 0x0140, 0xc301, 0x03c0, 0x0280, 0xc241,
  0xc601, 0x06c0, 0x0780, 0xc741, 0x0500, 0xc5c1, 0xc481, 0x0440,
  0xcc01, 0x0cc0, 0x0d80, 0xcd41, 0x0f00, 0xcfc1, 0xce81, 0x0e40,
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  0x8201, 0x42c0, 0x4380, 0x8341, 0x4100, 0x81c1, 0x8081, 0x4040
};


uint16_t CRC16(uint8_t *buf, unsigned int bsize)
{
    uint16_t crc = 0xffff;
          
    while (bsize--)
      crc = (uint16_t)(crc >> 8) ^ crc_16_tab[(crc ^ *buf++) & 0xff];
          
    return crc;
}

void SoftReset( void )
{
   __disable_interrupt();
   Reset();
}

uint8_t UTL_CalCheckSum8(uint8_t *ptr, uint32_t len)
{
	return ~UTL_CheckSum8(ptr, len) + 1;
}

uint8_t UTL_CheckSum8(uint8_t *ptr, uint32_t len)
{
   uint32_t i;
   uint8_t sum = 0;

   for ( i=0; i<len; i++, ptr++ ) {
      sum += *(ptr);
   }

   return sum;
}

uint32_t UTL_CalCheckSum32(uint8_t *ptr, uint32_t len)
{
	return ~UTL_CheckSum32(ptr, len) + 1;
}

uint32_t UTL_CheckSum32(uint8_t *ptr, uint32_t len)
{
   uint32_t i, sum=0;

   for ( i=0; i<len; i++, ptr++ ) {
      sum += *(ptr);
   }

   return sum;
}

static uint8_t u8_CrcHi = 0xFF;
static uint8_t u8_CrcLo = 0xFF;

/*******************************************************************************
	名称        	生成多项式              简记式*   标准引用
   CRC-4       	x4+x+1                  3         ITU G.704
   CRC-8       	x8+x5+x4+1              0x31
   CRC-8       	x8+x2+x1+1              0x07
   CRC-8       	x8+x6+x4+x3+x2+x1       0x5E
   CRC-12      	x12+x11+x3+x+1          80F
   CRC-16      	x16+x15+x2+1            8005      IBM SDLC
   CRC16-CCITT 	x16+x12+x5+1            1021      ISO HDLC, ITU X.25, V.34/V.41/V.42, PPP-FCS
   CRC-32      	x32+x26+x23+...+x2+x+1 04C11DB7 ZIP, RAR, IEEE 802 LAN/FDDI, IEEE 1394, PPP-FCS
*******************************************************************************/

/* Table of CRC values for high-order byte */
//IBM CRC16: X16 + X15 + X2 + 1 余式表
static const uint8_t u8_CrcTabHi[] = {
0x00, 0xC1, 0x81, 0x40, 0x01, 0xC0, 0x80, 0x41, 0x01, 0xC0, 0x80, 0x41, 0x00, 0xC1, 0x81, 0x40,
0x01, 0xC0, 0x80, 0x41, 0x00, 0xC1, 0x81, 0x40, 0x00, 0xC1, 0x81, 0x40, 0x01, 0xC0, 0x80, 0x41,
0x01, 0xC0, 0x80, 0x41, 0x00, 0xC1, 0x81, 0x40, 0x00, 0xC1, 0x81, 0x40, 0x01, 0xC0, 0x80, 0x41,
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0x00, 0xC1, 0x81, 0x40, 0x01, 0xC0, 0x80, 0x41, 0x01, 0xC0, 0x80, 0x41, 0x00, 0xC1, 0x81, 0x40
};

/* Table of CRC values for low-order byte */
static const uint8_t u8_CrcTabLo[] = {
0x00, 0xC0, 0xC1, 0x01, 0xC3, 0x03, 0x02, 0xC2, 0xC6, 0x06, 0x07, 0xC7, 0x05, 0xC5, 0xC4, 0x04,
0xCC, 0x0C, 0x0D, 0xCD, 0x0F, 0xCF, 0xCE, 0x0E, 0x0A, 0xCA, 0xCB, 0x0B, 0xC9, 0x09, 0x08, 0xC8,
0xD8, 0x18, 0x19, 0xD9, 0x1B, 0xDB, 0xDA, 0x1A, 0x1E, 0xDE, 0xDF, 0x1F, 0xDD, 0x1D, 0x1C, 0xDC,
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0x44, 0x84, 0x85, 0x45, 0x87, 0x47, 0x46, 0x86, 0x82, 0x42, 0x43, 0x83, 0x41, 0x81, 0x80, 0x40
};

uint16_t UTL_CalcCrc16( uint8_t u8_data )
{
    uint8_t u8_idx;

    u8_idx   = u8_CrcHi ^ u8_data ;
    u8_CrcHi = u8_CrcLo ^ u8_CrcTabHi[u8_idx] ;
    u8_CrcLo = u8_CrcTabLo[u8_idx];

    return( 0 );
}

uint16_t UTL_ChkCrc16( uint8_t* pu8_data, uint16_t u16_len )
{
    uint8_t u8_crch = 0xFF;      // initial high
    uint8_t u8_crcl = 0xFF;      // initial low
    uint16_t u16_idx;

    while( u16_len-- ) 
    {       // calcuate CRC
        u16_idx = u8_crch ^ *pu8_data++;
        u8_crch = u8_crcl ^ u8_CrcTabHi[u16_idx];
        u8_crcl = u8_CrcTabLo[u16_idx];
    }
    return( (u8_crch << 8) | u8_crcl );
}

bool UTL_blCheckCRC16(uint8_t *buf, uint16_t bsize)
{
    uint16_t crc;

    if(bsize<3)
    {
          return false;
    }

    crc=*(buf+bsize-2)*256+*(buf+bsize-1);
    if( crc == UTL_ChkCrc16(buf,bsize-2) )
    {
          return true;
    }

    return false;
}


/*ulPolynomial = 0x04c11db7*/
static const uint32_t u32_CrcTab[256] = {
0x00000000L, 0x04c11db7L, 0x09823b6eL, 0x0d4326d9L,
0x130476dcL, 0x17c56b6bL, 0x1a864db2L, 0x1e475005L,
0x2608edb8L, 0x22c9f00fL, 0x2f8ad6d6L, 0x2b4bcb61L,
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0xbcb4666dL, 0xb8757bdaL, 0xb5365d03L, 0xb1f740b4L
};

uint32_t UTL_CalcCrc32( uint8_t* pu8_data, uint32_t u32_len )
{
   uint32_t u32_crc;
   uint16_t u16_idx;

   u32_crc = 0xFFFFFFFF;
   while( u32_len-- ) {
      u16_idx = (u32_crc >> 24) ^ *pu8_data++;
      u32_crc = (u32_crc << 8 ) ^ u32_CrcTab[u16_idx];
   }

   return( u32_crc );
}

uint32_t UTL_FindRange( uint32_t u32_Num, uint32_t* u32p_Table, uint32_t u32_Len )
{
   uint32_t i;

   for ( i=1; i<u32_Len; i++ ) {
      if ( u32_Num <= u32p_Table[i] )
         break;
   }
   if ( i>=u32_Len ) i = u32_Len - 1;
   return i;
}

uint8_t UTL_Byte2Deci( uint8_t byte, uint8_t *buff )
{
   uint8_t temp, i=0;

   temp = byte / 100;
   if ( temp ) *(buff+i++) = temp + '0';
   byte = byte % 100;
   temp = byte / 10;
   if ( i || temp ) *(buff+i++) = temp + '0';
   temp = byte % 10;
   *(buff+i++) = temp + '0';
   *(buff+i) = '\0';
   return i;
}

void UTL_Byte2DeciS( uint8_t byte, uint8_t *buff, uint8_t ch )
{
   uint8_t temp, i=0, flag=0;

   temp = byte / 100;
   if ( temp ) {
      *(buff+i++) = temp + '0';
      flag = 1;
   }
   else {
      *(buff+i++) = ch;
   }
   byte = byte % 100;
   temp = byte / 10;
   if ( flag || temp ) {
      *(buff+i++) = temp + '0';
   }
   else {
      *(buff+i++) = ch;
   }
   temp = byte % 10;
   *(buff+i++) = temp + '0';
   *(buff+i) = '\0';
}

uint8_t UTL_Word2Deci( uint16_t word, uint8_t *buff )
{
   uint8_t temp, i;

   i = 0;
   temp = word / 10000;
   word = word % 10000;
   if ( temp ) *(buff+i++) = temp + '0';

   temp = word / 1000;
   word = word % 1000;
   if ( i || temp ) *(buff+i++) = temp + '0';

   temp = word / 100;
   word = word % 100;
   if ( i || temp ) *(buff+i++) = temp + '0';

   temp = word / 10;
   word = word % 10;
   if ( i || temp ) *(buff+i++) = temp + '0';

   *(buff+i++) = word + '0';
   *(buff+i) = '\0';
   return i;
}

void UTL_Word2DeciS( uint16_t word, uint8_t *buff, uint8_t ch )
{
   uint8_t temp, i, flag = 0;

   i = 0;
   temp = word / 10000;
   word = word % 10000;
   if ( temp ) {
      *(buff+i++) = temp + '0';
      flag = 1;
   }
   else {
      *(buff+i++) = ch;
   }

   temp = word / 1000;
   word = word % 1000;
   if ( flag || temp ) {
      *(buff+i++) = temp + '0';
      flag = 1;
   }
   else {
      *(buff+i++) = ch;
   }

   temp = word / 100;
   word = word % 100;
   if ( flag || temp ) {
      *(buff+i++) = temp + '0';
      flag = 1;
   }
   else {
      *(buff+i++) = ch;
   }

   temp = word / 10;
   word = word % 10;
   if ( flag || temp ) {
      *(buff+i++) = temp + '0';
   }
   else {
      *(buff+i++) = ch;
   }

   *(buff+i++) = word + '0';
   *(buff+i) = '\0';
}

static uint8_t btoh( uint8_t num )
{
   num = num & 0x0F;
   return( (num < 10 )? (num + '0') : (num - 10 + 'A') );
}

void UTL_Byte2Hex( uint8_t byte, uint8_t *buff )
{
   *buff++ = btoh( byte>>4 );
   *buff++ = btoh( byte );
   *buff = '\0';
}

void UTL_Word2Hex( uint16_t word, uint8_t *buff )
{
   *buff++ = btoh( (uint8_t)(word>>12) );
   *buff++ = btoh( (uint8_t)(word>>8) );
   *buff++ = btoh( ((uint8_t)word)>>4 );
   *buff++ = btoh( (uint8_t)(word) );
   *buff = '\0';
}

uint8_t UTL_Byte2Bcd( uint8_t byte )
{
   return (byte % 10) | ((( byte / 10 ) % 10 )<<4);
}

uint8_t UTL_Bcd2Byte( uint8_t bcd )
{
   return (bcd & 0x0F) + ((( bcd & 0xF0 )>>4) * 10 );
}

void UTL_Bcd2Ascii( uint8_t bcd, uint8_t *buff )
{
   *buff++ = ( bcd>>4 ) + '0';
   *buff++ = ( bcd &0xF ) + '0';
   *buff = '\0';
}

uint16_t UTL_WordDelta( uint16_t v1, uint16_t v2 )
{
   return( ( v1>v2 ) ? (v1-v2) : (v2-v1) );
}

uint8_t UTL_ByteDelta( uint8_t v1, uint8_t v2 )
{
   return( ( v1>v2 ) ? (v1-v2) : (v2-v1) );
}

uint8_t UTL_Word2Float( uint16_t word, uint8_t *buff, uint8_t deci )
{
   uint8_t len, i, p;

   len = UTL_Word2Deci( word, buff );
   if ( deci ) {
      if ( len==deci ) {
         for ( i=0; i<=deci; i++ ) {
            p = len - i;
            *(buff+p+2) = *(buff+p);
         }
         *buff = '0';
         *(buff+1) = '.';
         return ( len + 2 );
      }
      else if ( len < deci ) {
         for ( i=0; i<=len; i++ ){
            p = len - i;
            *(buff+p+deci) = *(buff+p);
         }
         for ( i=(deci - len); i>=1; i-- ){
            *(buff+i+1) = '0';
         }
         *buff = '0';
         *(buff+1) = '.';
         return ( deci+2 );
      }
      else {
         for ( i=0; i<=deci; i++ ) {
            p = len - i;
            *(buff+p+1) = *(buff+p);
         }
         *(buff+len-deci) = '.';
         return ( len + 1 );
      }
   }
   return len;
}

uint8_t UTL_Long2Float( uint32_t qbyte, uint8_t *buff, uint8_t deci )
{
   uint8_t len, i, p;

   len = UTL_Long2Deci( qbyte, buff, 10 );
   if ( deci ) {
      if ( len==deci ) {
         for ( i=0; i<=deci; i++ ) {
            p = len - i;
            *(buff+p+2) = *(buff+p);
         }
         *buff = '0';
         *(buff+1) = '.';
         return ( len+2 );
      }
      else if ( len < deci ) {
         for ( i=0; i<=len; i++ ){
            p = len - i;
            *(buff+p+deci) = *(buff+p);
         }
         for ( i=(deci - len); i>=1; i-- ){
            *(buff+i+1) = '0';
         }
         *buff = '0';
         *(buff+1) = '.';
         return ( deci+2 );
      }
      else {
         for ( i=0; i<=deci; i++ ) {
            p = len - i;
            *(buff+p+1) = *(buff+p);
         }
         *(buff+len-deci) = '.';
         return ( len+1 );
      }
   }
   return len;
}

uint32_t UTL_StrLen( uint8_t *str )
{
   uint32_t u32_i;

   for( u32_i=0; *str++!='\0'; u32_i++ );
   return( u32_i );
}

uint32_t UTL_IsBCD( uint8_t *buff, uint32_t len )
{
   uint32_t u32_i;
   uint8_t msb, lsb;

   for( u32_i=0; u32_i<len; u32_i++, buff++ ) {
      msb = (*buff) >> 4;
      lsb = (*buff) & 0x0F;
      if( (msb > 0x09) || (lsb > 0x09) ) {
         return( 0 );
      }
   }
   return( 1 );
}

//Vo = ( 10 mV/C * T ) + 600 mV
//T = 100 * Vo - 60
int16_t GetTemperatureC( uint16_t raw )
{
	int16_t temp;
	
	temp = (signed char)( (float)raw * 0.322266 - 60.0 );
	return( temp );
}

//摄氏温度转换为华氏温度：F=(9/5)*C+32   ,F为华氏温度
//华氏温度转换为摄氏温度：C =(5/9)*(F-32)   ,C为摄氏度
int16_t ConvertTempC2F( int16_t C )
{
	int16_t F;


	F=(9/5)*C+32;
	
	return( F );
}

void UTL_MemCpy( uint8_t *d, uint8_t *s, uint32_t len )
{
   uint32_t i;

   for( i=0; i<len; i++ ) {
      *d++ = *s++;
	}
}

uint8_t UTL_CopyStr2Mem( const uint8_t *s, uint8_t *d )
{
	uint16_t u16_i;
	
	for( u16_i=0; *s!=0; u16_i++ ) {
		*d++ = *s++;
	}
	return( u16_i );
}

void StrUpcase( int8_t* s_str, int8_t* d_str )
{
	while( *s_str != '\0' ) {
		if( (*s_str >= 'a') && (*s_str <= 'z') ) {
			*d_str =  *s_str - 0x20;
		}
		else {
			*d_str = *s_str;
		}
		s_str++;
		d_str++;
	}
	*d_str = '\0';
}

uint16_t StrLen( int8_t* str )
{
	uint16_t u16_len;
	
	u16_len = 0;
	while( *str != 0 ) {
		u16_len++;
		str++;
	}
	
	return( u16_len );
}

void* MemCpy( void* pv_dst, const void* pv_src, uint32_t u32_len )
{
   uint8_t* pu8_dst;
   uint8_t* pu8_src;
   uint32_t u32_i;
	
   pu8_dst = (uint8_t*)pv_dst;
   pu8_src = (uint8_t*)pv_src;
   for( u32_i=0; u32_i<u32_len; u32_i++ ) 
   {
    pu8_dst[u32_i] = pu8_src[u32_i];
   }

   return( pv_dst );
}

void MemSet( void* pv_mem, uint8_t u8_data, uint32_t u32_len )
{
   uint8_t* pu8_mem;
	uint32_t u32_i;
	
   pu8_mem = (uint8_t*)pv_mem;
	for( u32_i=0; u32_i<u32_len; u32_i++ ) {
		pu8_mem[u32_i] = u8_data;
	}
}

uint8_t Utils_FileNmChk( uint8_t* str )
{
   uint8_t u8_flg;

   u8_flg = 0;
   while( *str != '\0' ) {
      if( (*str == 0x5C) || //0x5C: '\'
          (*str == '/')  ||
          (*str == ':')  ||
          (*str == '*')  ||
          (*str == '?')  ||
          (*str == '"')  ||
          (*str == '<')  ||
          (*str == '>')  ||
          (*str == '|')  ||
          (*str <  ' ')  ||
          (*str > 0x7F) ) {
         u8_flg = 1;
         break;
      }
      str++;
   }

   return( u8_flg );
}

uint16_t Utils_DateNCmp( uint8_t* str1, uint8_t* str2, uint16_t u16_len )
{
   uint16_t u16_i;

   for( u16_i=0; u16_i<u16_len; u16_i++ ) {
      if( *str1++ < *str2++ ) {
         return( 0 );
      }
   }

   return( 1 );
}

bool Utils_CharArrayCmp( uint8_t* CharArr1, uint8_t* CharArr2, uint16_t u16_len )
{
   uint16_t u16_i;

   for( u16_i=0; u16_i<u16_len; u16_i++ ) 
   {
      if( *CharArr1++ != *CharArr2++ ) 
      {
         return( 0 );
      }
   }

   return( 1 );
}

/* EOF */